/* USER CODE BEGIN Header */
/**
  ******************************************************************************
  * @file           : main.c
  * @brief          : Main program body
  ******************************************************************************
  * @attention
  *
  * Copyright (c) 2024 STMicroelectronics.
  * All rights reserved.
  *
  * This software is licensed under terms that can be found in the LICENSE file
  * in the root directory of this software component.
  * If no LICENSE file comes with this software, it is provided AS-IS.
  *
  ******************************************************************************
  */
  /* USER CODE END Header */
  /* Includes ------------------------------------------------------------------*/
#include "main.h"
#include "adc.h"
#include "dma.h"
#include "i2c.h"
#include "spi.h"
#include "usart.h"
#include "gpio.h"

/* Private includes ----------------------------------------------------------*/
/* USER CODE BEGIN Includes */
#include "u8g2.h"
#include "oled.h"
#include "U8g2_text.h"
#include "Inf_TWASRPRO.h"
#include "Inf_W5500.h"
#include "Inf_Key.h"
#include "modbusMaster.h"
#include "App_Task.h"
/* USER CODE END Includes */

/* Private typedef -----------------------------------------------------------*/
/* USER CODE BEGIN PTD */
u8g2_t u8g2;
/* USER CODE END PTD */

/* Private define ------------------------------------------------------------*/
/* USER CODE BEGIN PD */

/* USER CODE END PD */

/* Private macro -------------------------------------------------------------*/
/* USER CODE BEGIN PM */

/* USER CODE END PM */

/* Private variables ---------------------------------------------------------*/

/* USER CODE BEGIN PV */

/* USER CODE END PV */

/* Private function prototypes -----------------------------------------------*/
void SystemClock_Config(void);
/* USER CODE BEGIN PFP */

/* USER CODE END PFP */

/* Private user code ---------------------------------------------------------*/
/* USER CODE BEGIN 0 */
//菜单级别选定
int Select_flag; // 正反 一次 双击 长按

//处理ui界面移动速度 值最好是2的倍数
int speed = 4;
int c_speed = 2;

int run_str(int* now, int* trag, const int speed, const int c_speed)
{
    int temp = 0;
    if (*now > *trag)
    {
        temp = ((*now - *trag) > c_speed) ? speed : c_speed;
        *now -= temp;
    }
    else if (*now < *trag)
    {
        temp = ((*trag - *now) > c_speed) ? speed : c_speed;
        *now += temp;
    }
    else
    {
        return 1;
    }
    return 0;
}



static const unsigned char logo[7][300] = {
{
        //0xF1,0xFF,0xFF,0xFF,0xFF,0x00,0xFC,0xFF,0xFF,0xFF,0xFF,0x03,0xFE,0xFF,0x07,0xFC,0xFF,0x07,0xFE,0xFF,0x00,0xE0,0xFF,0x07,0xFF,0x7F,0x78,0xC0,0xFF,0x0F,0xFF,0x1F,
        //0x7E,0x80,0xFF,0x0F,0xFF,0x0F,0x1F,0x00,0xFF,0x0F,0xFF,0x8F,0x03,0x00,0xFE,0x0F,0xFF,0xC7,0x01,0x00,0xFC,0x0F,0xFF,0xC7,0x01,0x00,0xFC,0x0F,0xFF,0xE3,0x00,0x00,
        //0xF8,0x0F,0xBF,0xE3,0x00,0x00,0x98,0x0F,0x9F,0x03,0x00,0x00,0x38,0x0F,0x8F,0x03,0x00,0x00,0x38,0x0F,0x87,0x01,0x00,0x00,0x38,0x0E,0x87,0x0F,0x00,0x00,0x3E,0x0E,
        //0x03,0x7F,0x00,0xC0,0x1F,0x0C,0x03,0xFC,0xFF,0xFF,0x07,0x0C,0x03,0xEC,0xFF,0xFF,0x3E,0x0C,0x07,0x3F,0xFE,0x0F,0x3F,0x0E,0x07,0x7F,0x00,0x00,0x3F,0x0E,0x1F,0x7F,
        //0xF0,0x03,0x3F,0x0F,0x3F,0x3E,0xF8,0x07,0xCE,0x0F,0xFF,0x18,0xF8,0x07,0xE0,0x0F,0xFF,0x03,0xF0,0x07,0xFC,0x0F,0xFF,0x3F,0xC0,0xC0,0xFF,0x0F,0xFF,0xFF,0xFF,0xFF,
        //0xFF,0x0F,0xFF,0xFF,0xFF,0xFF,0xFF,0x0F,0xFF,0xFF,0xFF,0xFF,0xFF,0x0F,0xFF,0xDF,0xFF,0xFF,0xFD,0x0F,0xFF,0xEF,0xFF,0xFF,0xFD,0x0F,0xFF,0xEF,0xFF,0xFB,0xFD,0x0F,
        //0xFF,0xEF,0xF7,0xFB,0xF9,0x0F,0xFF,0xE7,0xF7,0xFB,0xFB,0x0F,0xFF,0xF7,0xF7,0xF3,0xF3,0x0F,0xFF,0xF7,0xF7,0xF7,0xF7,0x0F,0xFF,0xFB,0xF7,0xF7,0xE7,0x0F,0xFF,0xFB,
        //0xF7,0xF7,0xEF,0x0F,0xFF,0xFD,0xF7,0xF7,0xEF,0x0F,0xFF,0xFF,0xF7,0xF7,0xFF,0x0F,0xFE,0xFF,0xF7,0xF7,0xFF,0x07,0xFE,0xFF,0xF7,0xF7,0xFF,0x07,0xFC,0xFF,0xFF,0xFF,
        //0xFF,0x03,0xF0,0xFF,0xFF,0xFF,0xFF,0x00,/*"C:\Users\longmao\Desktop\oled图标\ufo.bmp",0*/

        0xF0,0xFF,0xFF,0xFF,0xFF,0x01,0xFC,0xFF,0xFF,0xFF,0xFF,0x07,0xFE,0xFF,0xFF,0xFF,0xFF,0x0F,0xFE,0xF1,0xFF,0xFF,0xCF,0x0F,0xFF,0x81,0xFF,0xFF,0x87,0x1F,0xFF,0x03,
        0xFF,0xFF,0x03,0x1F,0xFF,0x07,0xFE,0xFF,0x01,0x1E,0xFF,0x0F,0xFC,0xFF,0x00,0x1C,0xFF,0x1F,0xF8,0x7F,0x00,0x18,0xFF,0x1F,0xF8,0x3F,0x00,0x18,0xFF,0x1F,0xF8,0x1F,
        0x00,0x1C,0xF3,0x1F,0xF0,0x0F,0x00,0x1E,0xE3,0x0F,0xF0,0x07,0x00,0x1F,0xC3,0x0F,0xF8,0x03,0x80,0x1F,0x83,0x01,0xF8,0x03,0xC0,0x1F,0x03,0x00,0xF0,0x01,0xE0,0x1F,
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        0xCF,0x0F,0xFC,0xFF,0xFF,0xFF,0xFF,0x07,0xF0,0xFF,0xFF,0xFF,0xFF,0x01,/*"C:\Users\longmao\Desktop\oled图标\setting.bmp",0*/
        },//Setting——设置
        {0xF0,0xFF,0xFF,0xFF,0xFF,0x00,0xFC,0xFF,0xFF,0xFF,0xFF,0x03,0xFE,0xFF,0x00,0xF0,0xFF,0x07,0xFE,0x3F,0x00,0xC0,0xFF,0x07,0xFF,0x0F,0x00,0x00,0xFF,0x0F,0xFF,0x03,
        0x00,0x00,0xFC,0x0F,0xFF,0x01,0x00,0x00,0xF8,0x0F,0xFF,0x00,0x00,0x00,0xF0,0x0F,0x7F,0x00,0x00,0x00,0xE0,0x0F,0x3F,0x00,0x60,0x00,0xC0,0x0F,0x1F,0x00,0x60,0x00,
        0x80,0x0F,0x1F,0x00,0x60,0x00,0x80,0x0F,0x0F,0x00,0x60,0x00,0x00,0x0F,0x0F,0x00,0x60,0x00,0x00,0x0E,0x07,0x00,0x60,0x00,0x00,0x0E,0x07,0x00,0x60,0x00,0x00,0x0E,
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        0xFF,0x03,0xF0,0xFF,0xFF,0xFF,0xFF,0x00,/*"C:\Users\longmao\Desktop\oled图标\time.bmp",0*/
        },//Clock——时钟
        {0xF0,0xFF,0xFF,0xFF,0xFF,0x00,0xFC,0xFF,0xFF,0xFF,0xFF,0x03,0xFE,0x07,0x00,0x00,0xFC,0x07,0xFE,0x07,0x00,0x00,0xFC,0x07,0xFF,0x07,0x00,0x00,0xFC,0x0F,0xFF,0xFF,
        0xFF,0xFF,0xFF,0x0F,0xFF,0x1F,0x00,0x80,0xFF,0x0F,0xFF,0x1F,0x00,0x80,0xFF,0x0F,0xFF,0x1F,0x00,0x80,0xFF,0x0F,0xFF,0x1F,0x00,0x80,0xFF,0x0F,0xFF,0x1F,0x00,0x80,
        0xFF,0x0F,0xFF,0x1F,0x00,0x80,0xFF,0x0F,0xFF,0x1F,0x00,0x80,0xFF,0x0F,0xFF,0x3F,0x00,0xC0,0xFF,0x0F,0xFF,0x3F,0x00,0xC0,0xFF,0x0F,0xFF,0x7F,0x00,0xE0,0xFF,0x0F,
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        0xFF,0x03,0xF0,0xFF,0xFF,0xFF,0xFF,0x00,/*"C:\Users\longmao\Desktop\oled图标\last.bmp",0*/
        },//Timer——时钟
        {0xF0,0xFF,0xFF,0xFF,0xFF,0x00,0xFC,0xFF,0xFF,0xFF,0xFF,0x03,0xFE,0xFF,0x07,0xFE,0xFF,0x07,0xFE,0xFF,0x00,0xE0,0xFF,0x07,0xFF,0x1F,0x00,0x80,0xFF,0x0F,0xFF,0x07,
        0x00,0x00,0xFE,0x0F,0xFF,0x03,0x00,0x00,0xFC,0x0F,0xFF,0x01,0x00,0x00,0xF8,0x0F,0xFF,0x00,0x00,0x00,0xF0,0x0F,0x7F,0x00,0x00,0x00,0xE0,0x0F,0x3F,0x00,0x00,0x00,
        0xC0,0x0F,0x1F,0xF8,0xFF,0xFF,0x81,0x0F,0x1F,0xF8,0xFF,0xFF,0x81,0x0F,0x0F,0xF8,0xFF,0xFF,0x01,0x0F,0x0F,0x38,0x00,0x80,0x01,0x0F,0x07,0x38,0x00,0x80,0x01,0x0E,
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        0xFF,0x03,0xF0,0xFF,0xFF,0xFF,0xFF,0x00,/*"C:\Users\longmao\Desktop\oled图标\data.bmp",0*/
        },//Calendar——日历
        {0xF0,0xFF,0xFF,0xFF,0xFF,0x00,0xFC,0xFF,0xFF,0xFF,0xFF,0x03,0xFE,0xFF,0xFF,0xFF,0xFF,0x07,0xFE,0xFF,0xFF,0xFF,0xFF,0x07,0xFF,0xFF,0xFF,0xFF,0xFF,0x0F,0xFF,0xFF,
        0xFF,0xFF,0xFF,0x0F,0xFF,0xFF,0xFF,0xFF,0xFF,0x0F,0xFF,0xFF,0xFF,0xFF,0xFF,0x0F,0xFF,0xFF,0xFF,0xFF,0xFF,0x0F,0xFF,0xFF,0x0F,0xFE,0xFF,0x0F,0xFF,0xFF,0x01,0xF0,
        0xFF,0x0F,0xFF,0xFF,0xE0,0xC0,0xF0,0x0F,0xFF,0x7F,0xFC,0x07,0xC0,0x0F,0xFF,0x3F,0xFE,0x1F,0x06,0x0F,0xFF,0x1F,0xFF,0x3F,0x3F,0x0E,0xFF,0x9F,0xFF,0x3F,0x7E,0x0E,
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        0xFF,0x03,0xF0,0xFF,0xFF,0xFF,0xFF,0x00,/*"C:\Users\longmao\Desktop\oled图标\weather.bmp",0*/
        },//Weather——天气
        {0xF0,0xFF,0xFF,0xFF,0xFF,0x00,0xFC,0xFF,0xFF,0xFF,0xFF,0x03,0xFE,0xFF,0xFF,0xFF,0xFF,0x07,0xFE,0xFF,0xFF,0xFF,0xFF,0x07,0xFF,0xFF,0xFF,0xFF,0xFF,0x0F,0xFF,0xFF,
        0xFF,0xFF,0xFF,0x0F,0xFF,0xFF,0xFF,0xFF,0xFF,0x0F,0xFF,0xC3,0xFF,0x3F,0xFC,0x0F,0xFF,0x80,0xFF,0x1F,0xF0,0x0F,0x7F,0x00,0xFF,0x0F,0xE0,0x0F,0x3F,0x1C,0x00,0x80,
        0xC3,0x0F,0x3F,0x3E,0x00,0xC0,0xC7,0x0F,0x1F,0x7E,0x00,0xE0,0x87,0x0F,0x0F,0xFF,0xFF,0xFF,0x8F,0x0F,0x8F,0xFF,0xFF,0xFF,0x0F,0x0F,0xCF,0xFF,0xFF,0xFF,0x18,0x0F,
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        0xFF,0x03,0xF0,0xFF,0xFF,0xFF,0xFF,0x00,/*"C:\Users\longmao\Desktop\oled图标\game.bmp",0*/
        },//Games——游戏
};



//菜单显示图片参数
int MainMenu_Select = 1;
int MainMenu_Picture_x = -22;
int MainMenu_Picture_x_target = -22;
int MainMenu_MaxNum = 5;//菜单显示最大数量 以0开始计数
//菜单显示字符名字参数
int MainMenu_Str_y = 78;
int MainMenu_Str_x = 34;
int MainMenu_Str_y_target = 64;
//菜单左侧弹出
int MainMenu_Rec_x = -6;
int MainMenu_Rec_x_target = 0;


/* 显示操作代码段  */
void ui_show(void);
void String_show(void);
void String_show2(void);
void Str_Coordinate_Add(void);
void Str_Coordinate_Decrease(void);
void Str_Operate(void);


/*  菜单选择操作代码段  */
typedef struct
{
    char* str;
    char num;
    int flag;
}MainSet_Str;



MainSet_Str MainMenu_Parameter[] =
{
    {"Setting",7,0},
    {"Clock",5,0},
    {"Timer",5,0},
    {"Calendar",8,0},
    {"Weather",7,0},
    {"Games",5,0},
};


typedef struct
{
    MainSet_Str Str_Pa[10];//二级菜单最大容量
    int select;//二级菜单的选择值
    int len;//从0开始算起有几个字符串
    int str_x;//开始字符串x轴的起始位置
    int str_x_target;
    int str_y;
    int str_y_target;
    int fram_select;//选择框的选择值
    int fram_x;
    int fram_x_target;
    int fram_y;
    int fram_y_target;
    int fram_h;
    int fram_w;
    int fram_w_target;
    int rate_y;//选择进度条的长度
    int rate_y_target;
    int rate_y_duan;//选择进度条的有几段，比如说有一米长的线条，有几个元素就分为几段，从而达到不同菜单下的长短
}MainSet_Str_All;

MainSet_Str_All Str_AllArray[] =
{
    {
        {{"aetting",7,0},{"alock",5,0},{"aimer",5,0},{"aalendar",8,0},},
        0,3,4,4,12,12,0,0,0,0,0,14,2,7,2,2,0},
    {	{{"betting",7,0},{"block",5,0},{"bimer",5,0},{"balendar",8,0},{"beather",7,0},{"bames",5,0},},
        0,5,4,4,12,12,0,0,0,0,0,14,7,7,2,2,0},
    {	{{"cetting",7,0},{"clock",5,0},{"cimer",5,0},{"calendar",8,0},{"ceather",7,0},{"cames",5,0},},
        0,5,4,4,12,12,0,0,0,0,0,14,7,7,2,2,0},
    {   {{"detting",7,0},{"dlock",5,0},{"cimer",5,0},{"dalendar",8,0},{"eeather",7,0},{"fames",5,0},},
        0,5,4,4,12,12,0,0,0,0,0,14,7,7,2,2,0},
    {   {{"eetting",7,0},{"elock",5,0},{"cimer",5,0},{"dalendar",8,0},{"eeather",7,0},{"fames",5,0},},
        0,5,4,4,12,12,0,0,0,0,0,14,7,7,2,2,0},
    {   {{"fetting",7,0},{"flock",5,0},{"cimer",5,0},{"dalendar",8,0},{"eeather",7,0},{"fames",5,0},},
        0,5,4,4,12,12,0,0,0,0,0,14,7,7,2,2,0},
};

typedef struct
{
    char current;
    char upper;
    char next;
    char enter;
    char back;
    void (*current_operation)(void);

}Menu_Operate;


Menu_Operate Table[] =
{
    //开始菜单
    {0,7,8,1,0,ui_show},
    //1级菜单
    {1,7,8,9,0,String_show},
    {2,7,8,9,0,String_show},
    {3,7,8,9,0,String_show},
    {4,7,8,9,0,String_show},
    {5,7,8,9,0,String_show},
    {6,7,8,9,0,String_show},
    //坐标操作
    {7,7,7,7,7,Str_Coordinate_Add},
    {8,8,8,8,8,Str_Coordinate_Decrease},
    //2级菜单
   {9,9,9,9,9,Str_Operate}

};

int func_index = 0;
int func_index_last = 0;
void (*current_operation_index)(void);


void ui_show(void)
{
    char i = 0;
    u8g2_SetFont(&u8g2, u8g2_font_t0_22b_tf);//设置菜单字符名字显示字体

    /*  显示代码段  */

    for (i = 0;i <= MainMenu_MaxNum;i++)//显示菜单图片
    {
        u8g2_DrawXBMP(&u8g2, MainMenu_Picture_x + i * 64, 0, 44, 44, logo[i]);
    }

    if (MainMenu_Select >= 0 && MainMenu_Select <= MainMenu_MaxNum)//显示菜单的字符名字
    {
        u8g2_DrawStr(&u8g2, MainMenu_Str_x, MainMenu_Str_y, MainMenu_Parameter[MainMenu_Select].str);
    }
    u8g2_DrawBox(&u8g2, MainMenu_Rec_x, 50, 8, 16);//左边弹出矩形

    /*  处理坐标代码段  */
    run_str(&MainMenu_Picture_x, &MainMenu_Picture_x_target, 32, c_speed);//对图片坐标进行移动
    run_str(&MainMenu_Str_y, &MainMenu_Str_y_target, speed, c_speed);//对图片字符名称坐标进行移动
    run_str(&MainMenu_Rec_x, &MainMenu_Rec_x_target, speed, c_speed);//弹出动画
}
void String_show(void)
{
    char i = 0;
    char temp = func_index - 1;
    Str_AllArray[temp].rate_y_duan = 64 / (Str_AllArray[temp].len + 1);

    u8g2_SetFont(&u8g2, u8g2_font_6x13_te);
    //显示字符
    for (i = 0; i <= Str_AllArray[temp].len; i++)
    {
        u8g2_DrawStr(&u8g2, Str_AllArray[temp].str_x, Str_AllArray[temp].str_y + i * 16, Str_AllArray[temp].Str_Pa[i].str);
        u8g2_DrawFrame(&u8g2, 90, Str_AllArray[temp].str_y + i * 16 - 8, 9, 9);//对应菜单下画空框
    }


    //画选择条
    //u8g2_DrawVLine(&u8g2, 124, 0, (Str_AllArray[temp].len/4+1)*64);
    u8g2_DrawRBox(&u8g2, 122, Str_AllArray[temp].rate_y, 6, Str_AllArray[temp].rate_y_duan, 2);
    u8g2_DrawRFrame(&u8g2, 122, 1, 6, 62, 2);
    u8g2_SetDrawColor(&u8g2, 2);
    //画选择框
    Str_AllArray[temp].fram_w_target = 7 * Str_AllArray[temp].Str_Pa[Str_AllArray[temp].select].num;
    u8g2_DrawRBox(&u8g2, Str_AllArray[temp].fram_x, Str_AllArray[temp].fram_y, Str_AllArray[temp].fram_w, Str_AllArray[temp].fram_h, 4);
    u8g2_SetDrawColor(&u8g2, 1);

    //画二级菜单确定框，扫码哪个一个被按下了，在这里可以加入自己想执行的代码
    for (i = 0; i <= Str_AllArray[temp].len; i++)
    {
        //测试案列
        if (temp == 1)
        {
            if (1 == Str_AllArray[temp].Str_Pa[i].flag)
            {
                u8g2_DrawBox(&u8g2, 90, Str_AllArray[temp].str_y + i * 16 - 8, 9, 9);//对应按下操作的显示实心方框	

                switch (i)
                {
                case 0:
                    // LED1_ON();
                    break;
                case 1:
                    // LED2_ON();
                    break;
                default:
                    // LED1_ON();
                    // LED2_ON();
                    break;
                }
            }
            else
            {
                switch (i)
                {
                case 0:
                    // LED1_OFF();
                    break;
                case 1:
                    // LED2_OFF();
                    break;
                }
            }
        }
    }

    run_str(&Str_AllArray[temp].str_y, &Str_AllArray[temp].str_y_target, speed, c_speed);
    run_str(&Str_AllArray[temp].fram_y, &Str_AllArray[temp].fram_y_target, speed, c_speed);
    run_str(&Str_AllArray[temp].fram_w, &Str_AllArray[temp].fram_w_target, 3, 1);
    run_str(&Str_AllArray[temp].rate_y, &Str_AllArray[temp].rate_y_target, speed, c_speed);
}


void Str_Coordinate_Add(void)
{
    //对主界面坐标操作
    if (func_index_last == 0)//图片向左移动
    {
        MainMenu_Select += 1;
        MainMenu_Picture_x_target -= 64;
        if (MainMenu_Select >= 0 && MainMenu_Select <= MainMenu_MaxNum)
        {
            //模拟字符从屏幕下方弹起效果		
            MainMenu_Str_y = 78;
            MainMenu_Str_y_target = 64;
            //模拟左边弹出效果，进行选择控制提醒效果
            MainMenu_Rec_x = -8;
            MainMenu_Rec_x_target = 0;

            // Beep_Work(Turn_ON);//进行蜂鸣器提醒
        }
        /*    限值代码段    */
        if (MainMenu_Picture_x_target >= 42)//进行左边最后一张图片限值
        {
            MainMenu_Picture_x_target = 42;
        }
        else if (MainMenu_Picture_x_target <= (-MainMenu_MaxNum * 64 + 42))//进行右闭最后一张图片限值
        {
            MainMenu_Picture_x_target = (-MainMenu_MaxNum * 64 + 42);
        }
        if (MainMenu_Select < 0)//进行菜单选择值限值
        {
            MainMenu_Select = 0;
        }
        else if (MainMenu_Select >= MainMenu_MaxNum)
        {
            MainMenu_Select = MainMenu_MaxNum;
        }
    }
    //对1级菜单坐标操作
    if (func_index_last >= 1 && func_index_last <= 6)
    {
        char temp = func_index_last - 1;
        Str_AllArray[temp].select++;

        if (Str_AllArray[temp].select >= 0 && Str_AllArray[temp].select <= Str_AllArray[temp].len)
        {
            // Beep_Work(Turn_ON);//进行蜂鸣器提醒
            Str_AllArray[temp].rate_y_target += Str_AllArray[temp].rate_y_duan;
            Str_AllArray[temp].fram_select = Str_AllArray[temp].select;

            if (Str_AllArray[temp].fram_select >= 0 && Str_AllArray[temp].fram_select <= 3)//是否对框下移动
            {
                Str_AllArray[temp].fram_y_target += 16;
            }
            else if (Str_AllArray[temp].select <= Str_AllArray[temp].len)//是否进行字符上移动
            {
                Str_AllArray[temp].str_y_target -= 16;
            }

            Str_AllArray[temp].fram_x_target = 7 * Str_AllArray[temp].Str_Pa[Str_AllArray[temp].select].num;
        }

        if (Str_AllArray[temp].select > Str_AllArray[temp].len)	//	进行限值
        {
            Str_AllArray[temp].select = Str_AllArray[temp].len;
        }

    }
    if (func_index == 7 || func_index == 8)//执行坐标加减函数后，在回到之前的索引值
    {
        func_index = func_index_last;
    }

}
void Str_Coordinate_Decrease(void)
{
    if (func_index_last == 0)//对主菜单坐标进行操作
    {
        MainMenu_Select -= 1;
        MainMenu_Picture_x_target += 64;
        if (MainMenu_Select >= 0 && MainMenu_Select <= MainMenu_MaxNum)
        {
            MainMenu_Str_y = 78;
            MainMenu_Str_y_target = 64;

            MainMenu_Rec_x = -8;
            MainMenu_Rec_x_target = 0;
            // Beep_Work(Turn_ON);//进行蜂鸣器提醒
        }
        /*    限值代码段    */
        if (MainMenu_Picture_x_target >= 42)//进行左边最后一张图片限值
        {
            MainMenu_Picture_x_target = 42;
        }
        else if (MainMenu_Picture_x_target <= (-MainMenu_MaxNum * 64 + 42))//进行右闭最后一张图片限值
        {
            MainMenu_Picture_x_target = (-MainMenu_MaxNum * 64 + 42);
        }
        if (MainMenu_Select < 0)//进行菜单选择值限值
        {
            MainMenu_Select = 0;
        }
        else if (MainMenu_Select >= MainMenu_MaxNum)
        {
            MainMenu_Select = MainMenu_MaxNum;
        }
    }
    //对一级菜单坐标操作
    if (func_index_last >= 1 && func_index_last <= 6)
    {
        char temp = func_index_last - 1;
        Str_AllArray[temp].select--;

        if (Str_AllArray[temp].select >= 0 && Str_AllArray[temp].select <= Str_AllArray[temp].len)
        {
            // Beep_Work(Turn_ON);//进行蜂鸣器提醒
            Str_AllArray[temp].rate_y_target -= Str_AllArray[temp].rate_y_duan;
            Str_AllArray[temp].fram_select = Str_AllArray[temp].select;
            if (Str_AllArray[temp].fram_select >= 0 && Str_AllArray[temp].fram_select < 3)//是否对框上移动
            {
                Str_AllArray[temp].fram_y_target -= 16;
            }
            else if (Str_AllArray[temp].select > 0)//是否进行字符下移动
            {
                Str_AllArray[temp].str_y_target += 16;
            }
        }
        if (Str_AllArray[temp].select < 0)	//	进行限值
        {
            Str_AllArray[temp].select = 0;
        }
    }

    if (func_index == 7 || func_index == 8)//执行坐标加减函数后，在回到之前的索引值
    {
        func_index = func_index_last;
    }

}


//	二级菜单操作各种选定执行,将对应一级菜单里面的MainSet_Str的flag就可以得知点击了哪个
void Str_Operate(void)
{
    int index = func_index_last - 1;

    if (Str_AllArray[index].Str_Pa[Str_AllArray[index].select].flag == 1)
    {
        Str_AllArray[index].Str_Pa[Str_AllArray[index].select].flag = 0;
    }
    else if (Str_AllArray[index].Str_Pa[Str_AllArray[index].select].flag == 0)
    {
        Str_AllArray[index].Str_Pa[Str_AllArray[index].select].flag = 1;
    }


    //执行二级菜单操作函数后，在回到之前的索引值
    func_index = func_index_last;
}
void Menu_Key_Set(void)
{
    func_index_last = func_index;
    if (Select_flag > 0)
    {
        switch (Select_flag)
        {
        case 1: func_index = Table[func_index].upper;break;
        case 2: func_index = Table[func_index].next;break;
        case 3: func_index = Table[func_index].enter;
            if (func_index == 1)
            {
                func_index += MainMenu_Select;
            }
            break;
        case 4: func_index = Table[func_index].back;break;
        case 5: func_index = 0;break;
        default: break;
        }
        Select_flag = 0;
    }
    if (func_index == 7 || func_index == 8 || func_index == 9)
    {
        current_operation_index = Table[func_index].current_operation;
        (*current_operation_index)();
    }
    current_operation_index = Table[func_index].current_operation;
    (*current_operation_index)();

    u8g2_SendBuffer(&u8g2);
    u8g2_ClearBuffer(&u8g2);
}
/* USER CODE END 0 */

/**
  * @brief  The application entry point.
  * @retval int
  */
int main(void)
{
    /* USER CODE BEGIN 1 */

    /* USER CODE END 1 */

    /* MCU Configuration--------------------------------------------------------*/

    /* Reset of all peripherals, Initializes the Flash interface and the Systick. */
    HAL_Init();

    /* USER CODE BEGIN Init */

    /* USER CODE END Init */

    /* Configure the system clock */
    SystemClock_Config();

    /* USER CODE BEGIN SysInit */

    /* USER CODE END SysInit */

    /* Initialize all configured peripherals */
    MX_GPIO_Init();
    MX_DMA_Init();
    MX_USART1_UART_Init();
    MX_USART2_UART_Init();
    MX_SPI2_Init();
    MX_USART3_UART_Init();
    MX_ADC1_Init();
    MX_I2C1_Init();
    /* USER CODE BEGIN 2 */
    printf("hello");
    Inf_Key_Init();

    u8g2Init(&u8g2);

    App_Task_Init();

    // testDrawXBM(&u8g2);
    // testDrawFrame(&u8g2);
    // testDrawProcess(&u8g2);
    // testDrawMulti(&u8g2);

    /* ------------以太网测试--------------- */
    // Inf_W5500_Init();
    // printf("初始化以太网成功...\r\n");
    // while (Inf_W5500_StartTcpClient() == 0) {
    //     HAL_Delay(1000);
    // }
    // printf("开启客户端成功....\r\n");
    // Inf_W5500_SendTcpData("hello world\r\n", 13);
    /* ------------以太网测试--------------- */


  /* USER CODE END 2 */

  /* Infinite loop */
  /* USER CODE BEGIN WHILE */
    while (1) {
        // Menu_Key_Set();
        // uint8_t key_code = Inf_Key_Scan(0);
        // if (key_code == 1) {
        //     // printf("key0 %d\n", key_value);
        //     Select_flag = 1;
        // }
        // else if (key_code == 2) {
        //     // printf("key1 %d\n", key_value);
        //     Select_flag = 3;
        // }
        // else if (key_code == 3) {
        //     // printf("key2 %d\n", key_value);
        //     Select_flag = 4;
        // }


        // TW_ASRPRO_SendData("123", 3);
        // HAL_Delay(5000);

        // u8g2_DrawCircle(&u8g2, 64, 32, 30, U8G2_DRAW_ALL); //画空心圆
        // u8g2_SendBuffer(&u8g2);
        // u8g2_DrawBox(&u8g2, 0, 0, 20, 20); //画实心方形
        // u8g2_DrawBox(&u8g2, 20, 20, 20, 20);//画实心方形
        // u8g2_SendBuffer(&u8g2);
        // u8g2_DrawFrame(&u8g2, 10, 40, 20, 20);//画空心方形
        // u8g2_SendBuffer(&u8g2);
        // u8g2_SetFont(&u8g2, u8g2_font_DigitalDiscoThin_tf);//设置字体集
        // u8g2_DrawStr(&u8g2, 30, 10, "freertos");//绘制字符串
        // u8g2_SendBuffer(&u8g2);

        /*
        u8g2_FirstPage(&u8g2);
        do {
            draw(&u8g2);
            //	   u8g2DrawTest(&u8g2);

            //	   u8g2_DrawBox(&u8g2,0,0,20,20); //画实心方形
            //	   u8g2_DrawBox(&u8g2,20,20,20,20);//画实心方形
            //	   u8g2_DrawFrame(&u8g2,10,40,20,20);//画空心方形
            // u8g2_SetFont(&u8g2, u8g2_font_DigitalDiscoThin_tf);//设置字体集
            // u8g2_DrawStr(&u8g2, 30, 10, "freedom");//绘制字符串
        } while (u8g2_NextPage(&u8g2));
        HAL_Delay(1000);        */

        /* USER CODE END WHILE */

        /* USER CODE BEGIN 3 */
    }
    /* USER CODE END 3 */
}

/**
  * @brief System Clock Configuration
  * @retval None
  */
void SystemClock_Config(void)
{
    RCC_OscInitTypeDef RCC_OscInitStruct = { 0 };
    RCC_ClkInitTypeDef RCC_ClkInitStruct = { 0 };
    RCC_PeriphCLKInitTypeDef PeriphClkInit = { 0 };

    /** Initializes the RCC Oscillators according to the specified parameters
    * in the RCC_OscInitTypeDef structure.
    */
    RCC_OscInitStruct.OscillatorType = RCC_OSCILLATORTYPE_HSE;
    RCC_OscInitStruct.HSEState = RCC_HSE_ON;
    RCC_OscInitStruct.HSEPredivValue = RCC_HSE_PREDIV_DIV1;
    RCC_OscInitStruct.HSIState = RCC_HSI_ON;
    RCC_OscInitStruct.PLL.PLLState = RCC_PLL_ON;
    RCC_OscInitStruct.PLL.PLLSource = RCC_PLLSOURCE_HSE;
    RCC_OscInitStruct.PLL.PLLMUL = RCC_PLL_MUL9;
    if (HAL_RCC_OscConfig(&RCC_OscInitStruct) != HAL_OK)
    {
        Error_Handler();
    }

    /** Initializes the CPU, AHB and APB buses clocks
    */
    RCC_ClkInitStruct.ClockType = RCC_CLOCKTYPE_HCLK | RCC_CLOCKTYPE_SYSCLK
        | RCC_CLOCKTYPE_PCLK1 | RCC_CLOCKTYPE_PCLK2;
    RCC_ClkInitStruct.SYSCLKSource = RCC_SYSCLKSOURCE_PLLCLK;
    RCC_ClkInitStruct.AHBCLKDivider = RCC_SYSCLK_DIV1;
    RCC_ClkInitStruct.APB1CLKDivider = RCC_HCLK_DIV2;
    RCC_ClkInitStruct.APB2CLKDivider = RCC_HCLK_DIV1;

    if (HAL_RCC_ClockConfig(&RCC_ClkInitStruct, FLASH_LATENCY_2) != HAL_OK)
    {
        Error_Handler();
    }
    PeriphClkInit.PeriphClockSelection = RCC_PERIPHCLK_ADC;
    PeriphClkInit.AdcClockSelection = RCC_ADCPCLK2_DIV6;
    if (HAL_RCCEx_PeriphCLKConfig(&PeriphClkInit) != HAL_OK)
    {
        Error_Handler();
    }
}

/* USER CODE BEGIN 4 */

/* USER CODE END 4 */

/**
  * @brief  Period elapsed callback in non blocking mode
  * @note   This function is called  when TIM1 interrupt took place, inside
  * HAL_TIM_IRQHandler(). It makes a direct call to HAL_IncTick() to increment
  * a global variable "uwTick" used as application time base.
  * @param  htim : TIM handle
  * @retval None
  */
void HAL_TIM_PeriodElapsedCallback(TIM_HandleTypeDef* htim)
{
    /* USER CODE BEGIN Callback 0 */

    /* USER CODE END Callback 0 */
    if (htim->Instance == TIM1) {
        HAL_IncTick();
    }
    /* USER CODE BEGIN Callback 1 */

    /* USER CODE END Callback 1 */
}

/**
  * @brief  This function is executed in case of error occurrence.
  * @retval None
  */
void Error_Handler(void)
{
    /* USER CODE BEGIN Error_Handler_Debug */
                /* User can add his own implementation to report the HAL error return state */
    __disable_irq();
    while (1)
    {
    }
    /* USER CODE END Error_Handler_Debug */
}

#ifdef  USE_FULL_ASSERT
/**
  * @brief  Reports the name of the source file and the source line number
  *         where the assert_param error has occurred.
  * @param  file: pointer to the source file name
  * @param  line: assert_param error line source number
  * @retval None
  */
void assert_failed(uint8_t* file, uint32_t line)
{
    /* USER CODE BEGIN 6 */
                /* User can add his own implementation to report the file name and line number,
                   ex: printf("Wrong parameters value: file %s on line %d\r\n", file, line) */
                   /* USER CODE END 6 */
}
#endif /* USE_FULL_ASSERT */
